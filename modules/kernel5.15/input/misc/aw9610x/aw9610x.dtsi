&i2c0 {
	status = "okay";
	aw9610x_sar@12 {
		compatible = "awinic,aw9610x_sar_0";
		reg = <0x12>;
		irq-gpio = <&pio 4 0>;
		aw9610x,using-firmware;
		sar-num = < 0 >;
		//vcc-supply = <&pm8953_l6>;
		status = "okay";
	};

	aw9610x_sar@13 {
		compatible = "awinic,aw9610x_sar_1";
		reg = < 0x13 >;
		irq-gpio = <&pio 1 0>;
		aw9610x,using-firmware;
		//vcc-supply = <&pm8953_l6>;
		sar-num = < 1 >;
		status = "okay";
	};
};
