## kernel5.15/kernel5.15/drivers/jx_msg_notifier/Kconfig
```kconfig
# SPDX-License-Identifier: GPL-2.0-only
#
# jx msg notifier drivers configuration
#

menu "jx msg notifier"

config JX_MSG_NOTIFIER
	tristate "jx msg notifier"
	help
	  Support jx msg notifier Feature

	  Say Y here to build support for jx msg notifier.
	  To compile this driver as a module, choose M here

endmenu
```

## kernel5.15/kernel5.15/drivers/zyt_info/Kconfig
```kconfig
# SPDX-License-Identifier: GPL-2.0-only
#
# ZYT INFO drivers configuration
#

menu "ZYT Info"

config ZYT_INFO
	tristate "ZYT Info"
	help
	  Support ZYT Info Feature

	  Say Y here to build support for ZYT Info.
	  To compile this driver as a module, choose M here

endmenu
```

## modules/kernel5.15/input/misc/stk3x3x/Kconfig
```kconfig
# STK3X3X start
config INPUT_STK3X3X_I2C
	tristate "STK3X3X proximity and light sensor device with I2C bus"
	depends on I2C
	default n
	help
	  Say Y here if you have a STK3X3X device on the board and use I2C
	  communication, else say N.

	  To compile this driver as a module, choose M here.  
# STK3X3X end
```
